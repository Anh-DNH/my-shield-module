## config/west.yml
```yaml
manifest:
  defaults:
    revision: v0.3
  remotes:
    - name: zmkfirmware
      url-base: https://github.com/zmkfirmware
    - name: badjeff
      url-base: https://github.com/badjeff
    - name: heinn-dev
      url-base: https://github.com/heinn-dev
    - name: nuovotaka
      url-base: https://github.com/nuovotaka
  projects:
    - name: zmk
      # remote: zmkfirmware
      remote: heinn-dev
      import: app/west.yml
    - name: zmk-analog-input-driver
      remote: badjeff
      revision: main
    - name: zmk-pointing-acceleration-alpha
      remote: nuovotaka
      revision: main
  self:
    path: config
```
